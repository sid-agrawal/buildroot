## package/libpfs/Config.in
```kconfig
config BR2_PACKAGE_LIBPFS
	bool "libpfs"
	help
	  Support for reading pfs

	  https://github.com/sid-agrawal/pfs
```

## package/python-pybind11/Config.in
```kconfig
config BR2_PACKAGE_PYTHON_PYBIND11
	bool "python-pybind11"
	help
	  Seamless operability between C++11 and Python.

	  https://github.com/pybind/pybind11
```
